#include <header.h>
GLCDINIT_t glcd_init_data;

const unsigned short MK16x8[] = {
        0x00, 0xFF, 0x02, 0x04, 0x08, 0x04, 0x02, 0xFF, 0x00, 0xFF, 0x18, 0x24, 0x42, 0x81, 0x00, 0x00,  
        0x00,0x00, 0xFF, 0x02, 0x04, 0x08, 0x04, 0x02, 0xFF, 0x00, 0xFF, 0x18, 0x24, 0x42, 0x81, 0x00, 
        0x00, 0x00,0x00, 0xFF, 0x02, 0x04, 0x08, 0x04, 0x02, 0xFF, 0x00, 0xFF, 0x18, 0x24, 0x42, 0x81,  
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        0xFF, 0x02, 0x04, 0x08, 0x04, 0x02, 0xFF, 0x00, 0xFF, 0x18, 0x24, 0x42, 0x81, 0x00, 0x00,0x00,   
        };
  
unsigned char R_data[8] = {0x01,0x02,0x04,0x08,0x10,0x20,0x40,0x80};

void q1()
{
    int min = 0, max = 8, col = 0, row = 0, index = 0, counter = 0;
    for (counter = 0; counter <= 15; counter++)
    {
        for (index = 0; index < 500; index++)
        {
            PORTD = 0x80;
            PORTB = ~MK16x8[row];
            PORTA = R_data[col % 8];
            delay_ms(1);
            PORTD = 0x00;
            PORTB = ~MK16x8[row + 8];
            PORTA = R_data[col % 8];
            col++;
            row++;
            if (row == max)
                row = min;
            delay_ms(1);
        }

        if (max == sizeof(MK16x8))
        {
            min = 0;
            max = 8;
            row = 0;
            col = 0;
        }
        else
        {
            min = min + 16;
            max = max + 16;
        }
    }
}

void q2()
{
    glcd_init_data.font = font5x7;
    glcd_init_data.readxmem = NULL;
    glcd_init_data.writexmem = NULL;
    glcd_init(&glcd_init_data);
    glcd_putimagef(0, 0, new_image, GLCD_PUTCOPY);
    delay_ms(3000);
}
void q3()
{

    unsigned long int dim1;
    unsigned long int dim2;
    unsigned int second = 0;
    unsigned int minute = 0;
    unsigned int hour = 0;
    glcd_init_data.font = font5x7;
    glcd_init_data.readxmem = NULL;
    glcd_init_data.writexmem = NULL;
    glcd_init(&glcd_init_data);
    while (1)
    {
        delay_ms(300);
        second++;
        if (second == 60)
        {
            minute++;
            second = 0;
        }
        if (minute == 60)
        {
            hour++;
            minute = 0;
        }
        if (hour == 12)
        {
            hour = 0;
        }
        glcd_clear();
        glcd_circle(63, 31, 30);
        glcd_setlinestyle(3, 4);
        glcd_circle(63, 31, 2);
        glcd_setlinestyle(1, GLCD_LINE_SOLID);
        dim1 = 25 * sin(second * (0.10471975512));
        dim2 = 25 * cos(second * (-0.10471975512));
        glcd_line(63, 31, dim1 + 63, 31 - dim2);
        dim1 = 20 * sin(minute * (0.10471975512));
        dim2 = 20 * cos(minute * (-0.10471975512));
        glcd_line(63, 31, dim1 + 63, 31 - dim2);
        dim1 = 15 * sin(hour * (0.10471975512));
        dim2 = 15 * cos(hour * (-0.10471975512));
        glcd_line(63, 31, dim1 + 63, 31 - dim2);
    }
}
void init()
{
DDRA = (1 << DDA7) | (1 << DDA6) | (1 << DDA5) | (1 << DDA4) | (1 << DDA3) | (1 << DDA2) | (1 << DDA1) | (1 << DDA0);
PORTA = (0 << PORTA7) | (0 << PORTA6) | (0 << PORTA5) | (0 << PORTA4) | (0 << PORTA3) | (0 << PORTA2) | (0 << PORTA1) | (0 << PORTA0);
DDRB = (1 << DDB7) | (1 << DDB6) | (1 << DDB5) | (1 << DDB4) | (1 << DDB3) | (1 << DDB2) | (1 << DDB1) | (1 << DDB0);
PORTB = (0 << PORTB7) | (0 << PORTB6) | (0 << PORTB5) | (0 << PORTB4) | (0 << PORTB3) | (0 << PORTB2) | (0 << PORTB1) | (0 << PORTB0);
DDRC = (1 << DDC7) | (1 << DDC6) | (1 << DDC5) | (1 << DDC4) | (1 << DDC3) | (1 << DDC2) | (1 << DDC1) | (1 << DDC0);
PORTC = (0 << PORTC7) | (0 << PORTC6) | (0 << PORTC5) | (0 << PORTC4) | (0 << PORTC3) | (0 << PORTC2) | (0 << PORTC1) | (0 << PORTC0);
DDRD = (1 << DDD7) | (1 << DDD6) | (1 << DDD5) | (1 << DDD4) | (1 << DDD3) | (1 << DDD2) | (1 << DDD1) | (1 << DDD0);
PORTD = (0 << PORTD7) | (0 << PORTD6) | (0 << PORTD5) | (0 << PORTD4) | (0 << PORTD3) | (0 << PORTD2) | (0 << PORTD1) | (0 << PORTD0);
}